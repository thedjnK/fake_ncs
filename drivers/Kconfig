## drivers/Kconfig
```kconfig
#
# Copyright (c) 2018-2020 Nordic Semiconductor ASA
#
# SPDX-License-Identifier: LicenseRef-Nordic-5-Clause
#

menu "Device Drivers"

rsource "bluetooth/Kconfig"
rsource "entropy/Kconfig"

if !MPSL_FEM_ONLY
rsource "mpsl/Kconfig"
endif

rsource "regulator/Kconfig"

config CLOCK_CONTROL_NRF2
	bool "Use NRF2 clock control API"
	depends on CLOCK_CONTROL
	depends on SOC_SERIES_NRF54H && !RISCV_CORE_NORDIC_VPR
	default y
	help
	  The clock control drivers are currently split into two groups,
	  one which implement the "NRF2" clock control API, and one which
	  implements the "NRF" clock control API. This config helps
	  applications and subsystems align to the clock control API
	  implemented for an SoC.

	  This config can be removed once all clock control drivers have
	  been updated to use the "NRF2" API.

endmenu
```

## lib/Kconfig
```kconfig
#
# Copyright (c) 2018 Nordic Semiconductor ASA
#
# SPDX-License-Identifier: LicenseRef-Nordic-5-Clause
#

menu "Libraries"

rsource "multithreading_lock/Kconfig"
rsource "hw_unique_key/Kconfig"
rsource "identity_key/Kconfig"

endmenu
```

## subsys/Kconfig
```kconfig
#
# Copyright (c) 2018 - 2020 Nordic Semiconductor
#
# SPDX-License-Identifier: LicenseRef-Nordic-5-Clause
#

menu "Subsystems"

rsource "bootloader/Kconfig"
rsource "bluetooth/Kconfig"
rsource "mpsl/Kconfig"
rsource "nrf_security/Kconfig"

endmenu
```

## subsys/bootloader/Kconfig
```kconfig
#
# Copyright (c) 2018 Nordic Semiconductor ASA
#
# SPDX-License-Identifier: LicenseRef-Nordic-5-Clause
#

menu "Bootloader"

config MCUBOOT_BOOTLOADER_SIGNATURE_TYPE_ED25519
	bool "Use ED25519 signature"
	help
	  This is a Kconfig which is informative only, the value should not be changed.

config MCUBOOT_BOOTLOADER_SIGNATURE_TYPE_PURE
	bool "Signature is verified over an image rather than sha of an image"
	help
	  This is a Kconfig which is informative only, the value should not be changed.

endmenu
```

## subsys/mpsl/Kconfig
```kconfig
#
# Copyright (c) 2019 - 2020 Nordic Semiconductor ASA
#
# SPDX-License-Identifier: LicenseRef-Nordic-5-Clause
#

menu "Multiprotocol service layer (MPSL)"

rsource "cx/Kconfig"
rsource "init/Kconfig"
rsource "pm/Kconfig"
rsource "clock_ctrl/Kconfig"

endmenu
```

## sysbuild/Kconfig.mcuboot
```kconfig
# Copyright (c) 2023 Nordic Semiconductor
#
# SPDX-License-Identifier: LicenseRef-Nordic-5-Clause

menu "MCUboot configuration"
	depends on BOOTLOADER_MCUBOOT

menuconfig MCUBOOT_HARDWARE_DOWNGRADE_PREVENTION
	bool "Downgrade prevention using hardware security counters"
	depends on (SOC_NRF5340_CPUAPP || SOC_SERIES_NRF91 || SOC_SERIES_NRF54L || SOC_SERIES_NRF54H)
	depends on !SECURE_BOOT_APPCORE
	depends on !QSPI_XIP_SPLIT_IMAGE
	help
	  This option can be enabled by the application and will ensure that the
	  MCUBOOT_HW_DOWNGRADE_PREVENTION Kconfig option is enabled in the MCUboot image.

	  Note that this can only be used on first image, it will not be applied to the second
	  image (network core updates) on nRF5340 which will use software downgrade protection
	  on the network core CPU instead.

if MCUBOOT_HARDWARE_DOWNGRADE_PREVENTION

config MCUBOOT_HW_DOWNGRADE_PREVENTION_COUNTER_SLOTS
	int "Number of available hardware counter slots"
	default 240
	range 2 288 if SOC_SERIES_NRF54L
	range 2 300
	depends on !SOC_SERIES_NRF54H
	help
	  When MCUBOOT_HW_DOWNGRADE_PREVENTION is enabled, MCUboot will use one hardware counter
	  for each updatable image (UPDATEABLE_IMAGE_NUMBER). This configuration specifies how many
	  counter slots will be allocated for each hardware counter. The hardware counters are
	  stored in OTP storage. The rationale for the default number (240): Assume one update a
	  month for 10 years, then double that value just in case. This default fits comfortably
	  within the OTP region of UICR.

config MCUBOOT_HW_DOWNGRADE_PREVENTION_COUNTER_VALUE
	int "Security counter value"
	default 1
	range 1 65535 if !SOC_SERIES_NRF54H
	range 1 4294967295 if SOC_SERIES_NRF54H
	help
	  The security counter value for this image.
	  This is the value that will be passed to the --security-counter parameter of imgtool.py

endif # MCUBOOT_HARDWARE_DOWNGRADE_PREVENTION

if BOOTLOADER_MCUBOOT

choice BOOT_SIGNATURE_TYPE
	default BOOT_SIGNATURE_TYPE_RSA if THINGY91_STATIC_PARTITIONS_FACTORY
	default BOOT_SIGNATURE_TYPE_ED25519 if SOC_SERIES_NRF54L || SOC_SERIES_NRF54H
	default BOOT_SIGNATURE_TYPE_ECDSA_P256 if ((SOC_NRF52840 || SOC_SERIES_NRF91) && !BOARD_THINGY91_NRF9160 && !BOARD_THINGY91_NRF52840)
	default BOOT_SIGNATURE_TYPE_ECDSA_P256 if SECURE_BOOT_APPCORE

endchoice

choice MCUBOOT_MODE
	default MCUBOOT_MODE_SWAP_USING_MOVE

endchoice

config BOOT_SIGNATURE_TYPE_PURE
	bool "Verify signature directly over image"
	depends on SOC_SERIES_NRF54L || SOC_SERIES_NRF54H
	depends on BOOT_SIGNATURE_TYPE_ED25519
	help
	  The image signature will be verified over image rather than
	  hash of an image.
	  This option is currently only supported with ED25519 and configurations
	  where both image slots are within internal SoC device storage.

config BOOT_IMG_HASH_ALG_SHA512
	bool "Use SHA512 for image hash calculation"
	depends on BOOT_SIGNATURE_TYPE_ED25519
	default y if SOC_SERIES_NRF54L || SOC_SERIES_NRF54H
	help
	  The image hash will be calculated using SHA512 algorithm.

config MCUBOOT_SIGNATURE_USING_KMU
	bool "Use KMU stored keys for signature verification"
	depends on SOC_SERIES_NRF54L
	depends on BOOT_SIGNATURE_TYPE_ED25519
	help
	  The device needs to be provisioned with proper set of keys.

config MCUBOOT_GENERATE_DEFAULT_KMU_KEYFILE
	bool "Generate default keyfile for provisioning during build"
	depends on SOC_SERIES_NRF54L
	depends on MCUBOOT_SIGNATURE_USING_KMU
	help
	  If enabled, the build system will generate keyfile.json file in the build directory.

endif

endmenu
```

## sysbuild/Kconfig.sysbuild
```kconfig
#
# Copyright (c) 2022 Nordic Semiconductor
#
# SPDX-License-Identifier: LicenseRef-Nordic-5-Clause
#

# This file contains extra images which can be used with sysbuild based builds.

config BUILD_OUTPUT_BIN
	bool "Build a binary in BIN format"
	default y
	help
	  Build a "raw" binary zephyr/zephyr.bin in the build directory.
	  The name of this file can be customized with CONFIG_KERNEL_BIN_NAME.
	  This will be applied to all target images.

config BUILD_OUTPUT_HEX
	bool "Build a binary in HEX format"
	default y
	help
	  Build an Intel HEX binary zephyr/zephyr.hex in the build directory.
	  The name of this file can be customized with CONFIG_KERNEL_BIN_NAME.
	  This will be applied to all target images.

rsource "Kconfig.mcuboot"
rsource "Kconfig.approtect"
rsource "Kconfig.cracen"
```

## west.yml
```yaml
# The west manifest file (west.yml) for the nRF Connect SDK (NCS).
#
# The per-workspace west configuration file, ncs/.west/config,
# specifies the location of this manifest file like this:
#
#     [manifest]
#     path = nrf
#
# See the west documentation for more information:
#
# https://developer.nordicsemi.com/nRF_Connect_SDK/doc/latest/zephyr/guides/west/index.html

manifest:
  version: "0.13"

  # "remotes" is a list of locations where git repositories are cloned
  # and fetched from.
  remotes:
    # nRF Connect SDK GitHub organization.
    # NCS repositories are hosted here.
    - name: ncs
      url-base: https://github.com/nrfconnect
    # Third-party repository sources:
    - name: zephyrproject
      url-base: https://github.com/zephyrproject-rtos

  # If not otherwise specified, the projects below should be obtained
  # from the ncs remote.
  defaults:
    remote: ncs

  # "projects" is a list of git repositories which make up the NCS
  # source code.
  #
  # For 'userdata' fields in the projects area, please refer to:
  # https://developer.nordicsemi.com/nRF_Connect_SDK/doc/latest/nrf/dm_code_base.html
  projects:
    # The Zephyr RTOS fork in the NCS, along with the subset of its
    # modules which NCS imports directly.
    #
    # https://developer.nordicsemi.com/nRF_Connect_SDK/doc/latest/zephyr/introduction/index.html
    # https://developer.nordicsemi.com/nRF_Connect_SDK/doc/latest/zephyr/guides/modules.html
    - name: zephyr
      repo-path: zephyr
      revision: main
      remote: zephyrproject
      import:
        # In addition to the zephyr repository itself, NCS also
        # imports the contents of zephyr/west.yml at the above
        # revision. Only the projects explicitly named in the
        # following allowlist are imported.
        #
        # Note that the zephyr west extensions (like 'build', 'flash',
        # 'debug', etc.) are automatically provided by this import, so
        # there's no need to add a redundant west-commands: key for
        # the zephyr project.
        #
        # Please keep this list sorted alphabetically.
        name-allowlist:
          - canopennode
          - chre
          - cmsis
          - cmsis-dsp
          - cmsis-nn
          - cmsis_6
          - edtt
          - fatfs
          - hal_nordic
          - hal_st # required for ST sensors (unrelated to STM32 MCUs)
          - hal_tdk # required for Invensense sensors such as ICM42670
          - hal_wurthelektronik
          - hostap
          - liblc3
          - libmetal
          - libsbc
          - littlefs
          - loramac-node
          - lvgl
          - lz4
          - mipi-sys-t
          - nanopb
          - net-tools
          - nrf_hw_models
          - nrf_wifi
          - open-amp
          - percepio
          - picolibc
          - segger
          - tf-m-tests
          - uoscore-uedhoc
          - zcbor
          - zscilib

    # NCS repositories.
    #
    # Some of these are also Zephyr modules which have NCS-specific
    # changes.
    - name: mbedtls
      path: modules/crypto/mbedtls
      repo-path: sdk-mbedtls
      revision: d77330677bef8221fff58c88fd0cd9ab4fd33cd8
    - name: oberon-psa-crypto
      path: modules/crypto/oberon-psa-crypto
      repo-path: sdk-oberon-psa-crypto
      revision: fd1f2aa156d8beb78584dfbaf30df30bf8f6568f
    - name: nrfxlib
      repo-path: sdk-nrfxlib
      path: nrfxlib
      revision: cd973eca82fb2e44cc58a150476454d3e5e0d7d5

  # West-related configuration for the nrf repository.
  self:
    # This repository should be cloned to ncs/nrf.
    path: nrf
    # This line configures west extensions.
    west-commands: scripts/west-commands.yml
```
